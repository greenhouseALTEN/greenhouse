#include "Display.h"
#include "Miscellaneous.h"
#include "SeeedGrayOLED.h"
#include "Clock.h"
#include "Watering.h"
  
/*
=================================================================
|| Run the function that corresponds to selected display mode. ||
================================================================= */
void Display::printToScreen(unsigned short moistureValue1, unsigned short moistureValue2, unsigned short moistureValue3, unsigned short moistureValue4, unsigned short moistureMeanValue, unsigned short tempValue, unsigned short humidityValue, uint16_t lightValue, uint16_t uvValue) {
  SeeedGrayOled.setVerticalMode();            //Display must be set vertical addressing mode to make any text printed to display, readable.
  switch(displayState) {
    case STARTUP_IMAGE:
      viewStartupImage();                     //Initialize the OLED Display and print startup images to display.
      break;
    case SET_CLOCK:
      stringToDisplay(0, 7, "SET CLOCK");     //Print current display state to upper right corner of display.
      viewSetClock();                         //Display "set time" screen.
      Clock::getInstance().setTime();         //Set current time.
      break;
    case READOUT_VALUES:
      stringToDisplay(0, 2, "READOUT VALUES");//Print current display state to upper right corner of display.
      viewReadoutValues(moistureMeanValue, tempValue, humidityValue, lightValue, uvValue);                  //Print read out values from the greenhouse to display.
      break;
    case SERVICE_MODE:
      stringToDisplay(0, 4, "SERVICE MODE");  //Print current display state to upper right corner of display.
      //viewServiceMode();                    //Service mode screen is printed to display.
      break;
    case FLOW_FAULT:
      stringToDisplay(0, 6, "FLOW FAULT");    //Print current display state to upper right corner of display.
      //waterFlowFault = resolveFlowFault();  //Water flow fault display mode is printed to display. It contains fault code instruction and possibility to reset fault code.  
      break;
  }
}

/*
======================================================================================
|| Toggle set modes and screen display modes when clockModeButton is being pressed. ||
====================================================================================== */
 void Display::toggleDisplayMode() {
  if((millis() - pressTimePrev) >= DEBOUNCE_TIME_PERIOD) {  //Debouncing button press to avoid multiple interrupts, display toggles.

    //Check if water flow fault code is active. If it is set 'true', FLOW_FAULT display will be activated next time mode-button is being pressed to let user resolve the fault code.
    if(waterFlowFault == true) {
      displayState = FLOW_FAULT;                //Set next display mode to be printed to display. 
    }
    switch(displayState) {
      case SET_CLOCK:
        switch(clockInputState) {
          case HOUR2:
            clockInputState = HOUR1;              //Hour pointer2 has been set. Continue by setting hour pointer1.
            Config::State().clockInputState_x = 1;                //Temp variable because of typedef could not be global variable.
            Serial.println("hour1InputMode");
            break;
          case HOUR1:
            clockInputState = MINUTE2;            //Hour pointer1 has been set. Continue by setting minute pointer2.
            Config::State().clockInputState_x = 2;                 //Temp variable because of typedef could not be global variable.
            Serial.println("minute2InputMode");
            break;
          case MINUTE2:
            clockInputState = MINUTE1;            //Minute pointer2 has been set. Continue by setting minute pointer1.
            Config::State().clockInputState_x = 3;                 //Temp variable because of typedef could not be global variable.
            Serial.println("minute1InputMode");
            break;
          case MINUTE1:
            clockInputState = COMPLETED;          //Clock setting completed.
            Config::State().clockStartEnabled = true;             //Start clock. Clock starts ticking.
            Serial.println("clockSettingCompleted");
            break;
          case COMPLETED:
            displayState = READOUT_VALUES;        //Set next display mode to be printed to display.
            alarmMessageEnabled = true;           //Enable any alarm message to be printed to display.
            greenhouseProgramStart = true;        //Start greenhouse program.
            Serial.println("READOUT_VALUES");
            break;           
        }
        break;
      case READOUT_VALUES:
        displayState = SERVICE_MODE;              //Set next display mode to be printed to display.
        alarmMessageEnabled = false;              //Disable any alarm message from being printed to display.
        Serial.println("SERVICE_MODE");
        break;
      case SERVICE_MODE:
        displayState = READOUT_VALUES;            //Set next display mode to be printed to display.
        alarmMessageEnabled = false;              //Disable any alarm message from being printed to display.
        Serial.println("READOUT_VALUES");     
        break;
      case FLOW_FAULT:
        greenhouseProgramStart = false;           //Stop greenhouse program.
        alarmMessageEnabled = false;              //Disable any alarm message from being printed to display.
        Serial.println("FLOW_FAULT"); 

        //In flow fault display mode user will have the chance to clear the fault code. Check if water flow fault code has been cleared by user or not.
        if(waterFlowFault == false) {               //Fault code has been cleared by user. Continue to run greenhouse program.               
          displayState = SERVICE_MODE;              //Since using interrupt for toggeling display mode, next display mode to be printed to display is READOUT_VALUES even though SERVICE_MODE display is set active mode here.
          greenhouseProgramStart = true;            //Continue greenhouse program.
          alarmMessageEnabled = true;               //Enable any alarm message from being printed to display.
          Serial.println("Resume program");  
        }
        else if(waterFlowFault == true) {           //If flow fault code has not been cleared, reboot greenhouse program.
          waterFlowFault = false;                   //Clear water flow fault code.
          displayState = STARTUP_IMAGE;             //Set next display mode to be printed to display.  
          //Watering::getInstance().stopPump();       //Stop water pump.
          //Clock::getInstance().resetTime();         //Reset clock time.   //MOVE TO OTHER FUNCTION INSTEAD!
          Serial.println("Reboot program");             
        }
        break;
    }
    pressTimePrev = millis();
  }
}

/*
===================================
|| Print custom text to display. ||
=================================== */
void Display::stringToDisplay(unsigned char x, unsigned char y, char* text) {
  y *= 8;                                         //To align symbol with rest printed text. Each symbol requires 8px in width.
  SeeedGrayOled.setTextXY(x, y);                  //Set cordinates to where text will be printed. X = row (0-7), Y = column (0-127).
  SeeedGrayOled.putString(text);                  //Print text to display.
}

/*
=======================================
|| Print number variable to display. ||
======================================= */
void Display::numberToDisplay(unsigned char x, unsigned char y, unsigned short variable) {
  y *= 8;                                         //To align symbol with rest printed text. Each symbol requires 8px in width.
  SeeedGrayOled.setTextXY(x, y);                  //Set cordinates to where text will be printed. X = row (0-7), Y = column (0-127).
  SeeedGrayOled.putNumber(variable);              //Print value to display.
}

/*
======================================================
|| Clear any character/s (print blanks) at display. ||
====================================================== */
void Display::blankToDisplay(unsigned char x, unsigned char y, int numOfBlanks) {
  y *= 8;                                         //To align symbol with rest printed text. Each symbol requires 8px in width.
  for(int i=0; i<numOfBlanks; i++) {              //Print blank space to display. Each loop one blank space is printed.
    SeeedGrayOled.setTextXY(x, y);                //Set cordinates to where text will be printed. X = row (0-7), Y = column (0-127).
    SeeedGrayOled.putString(" ");                 //Blank symbol.
    y++;                                          //Increase column cordinate to print next blank space in the same row.
  }
}

/*
=========================================================================================
|| Alternate print and clear intiger value (flash) to display with a frequency of 2Hz. ||
========================================================================================= */
void Display::flashNumberDisplay(unsigned short x, unsigned short y, unsigned short variable) {
  unsigned short numDigits;               //Store number of digits in variable value;
  y *= 8;                                     //To align symbol with rest printed text. Each symbol requires 8px in width.
  if(variable == 0) {                         //If variable equal to 0 it contains 1 digit.
    numDigits = 1;
  }
  while(variable != 0) {
    numDigits++;
    variable /= 10;                           //Result of division between values with type 'int' only gives an integer. If variable less than 10 result of division is 0.
  }

  //Toggle between printing variable value and printing blank space to make number appear to flash on display.
  switch(Config::State().flash) {
    case true:
      for(int i=0; i<numDigits; i++) {          //Print blank space to display. Each loop one blank space is printed.
        SeeedGrayOled.setTextXY(x, y);          //Set cordinates to where text will be printed. X = row (0-7), Y = column (0-127).
        SeeedGrayOled.putString(" ");           //Blank symbol.
        y += 8;                                 //Increase column cordinate to print next blank space in the same row.
      }
      break;
    case false:
      SeeedGrayOled.setTextXY(x, y);            //Set cordinates to where text will be printed. X = row (0-7), Y = column (0-127).
      SeeedGrayOled.putNumber(variable);        //Print variable value.
      break;
  }
}

/*
=========================================================================================
|| Alternate print and clear intiger value (flash) to display with a frequency of 2Hz. ||
========================================================================================= */
void Display::flashCharacterDisplay(unsigned short x, unsigned short y, char symbol) {
  y *= 8;                                     //To align symbol with rest printed text. Each symbol requires 8px in width.

  //Toggle between printing symbol and printing blank space to make symbol appear to flash on display.
  switch(Config::State().flash) {
    case true:
      SeeedGrayOled.setTextXY(x, y);          //Set cordinates to where text will be printed. X = row (0-7), Y = column (0-127).
      SeeedGrayOled.putString(" ");           //Blank symbol.
      break;
    case false:
      SeeedGrayOled.setTextXY(x, y);            //Set cordinates to where text will be printed. X = row (0-7), Y = column (0-127).
      SeeedGrayOled.putChar(symbol);            //Print variable value.
      break;
  }
}

/*
=========================================================================
|| Print current clock values to display to let user set current time. ||
========================================================================= */
void Display::viewSetClock() {
  
  stringToDisplay(2, 0, "Set current time");
  stringToDisplay(3, 0, "Use the buttons:");
  stringToDisplay(5, 0, "SET = inc. p.val");
  stringToDisplay(6, 0, "MODE = h or min");
 
  stringToDisplay(9, 4, "HH MM SS");
  //Flash separator between hour-minute and minute-second cursors when clock is ticking.
  if(Config::State().clockStartEnabled == true) {
    flashCharacterDisplay(10, 6, ':');
    flashCharacterDisplay(10, 9, ':');
  }
  else {
    stringToDisplay(10, 6, ":");
    stringToDisplay(10, 9, ":");
  }

  numberToDisplay(10, 4, Config::State().hourCursor2);
  numberToDisplay(10, 5, Config::State().hourCursor1);
  numberToDisplay(10, 7, Config::State().minuteCursor2);
  numberToDisplay(10, 8, Config::State().minuteCursor1);
  numberToDisplay(10, 10, Config::State().secondCursor2);
  numberToDisplay(10, 11, Config::State().secondCursor1);
  
  //Flash (show/clear) individual clock cursors to display which clock parameter that is currently being set.
  switch(clockInputState) {
    case HOUR2:
      flashNumberDisplay(10, 4, Config::State().hourCursor2);    //Toggle show/clear clock cursor with a frequency of 2 Hz.
      break;
    case HOUR1:
      flashNumberDisplay(10, 5, Config::State().hourCursor1);    //Toggle show/clear clock cursor with a frequency of 2 Hz.
      break;
    case MINUTE2:
      flashNumberDisplay(10, 7, Config::State().minuteCursor2);  //Toggle show/clear clock cursor with a frequency of 2 Hz.
      break;
    case MINUTE1:
      flashNumberDisplay(10, 8, Config::State().hourCursor1);    //Toggle show/clear clock cursor with a frequency of 2 Hz.
      break;
  }
}

/*
===================================================
|| Print readout values from sensors to display. ||
=================================================== */
void Display::viewReadoutValues(unsigned short moistureMeanValue, unsigned short tempValue, unsigned short humidityValue, uint16_t lightValue, uint16_t uvValue) {
  //Clear redundant value digits from previous readouts for all sensor values. Function takes the following parameters: (Row number, column number, number of blank spaces to be printed).
  blankToDisplay(2, 11, 3);                     //Moisture value.
  blankToDisplay(3, 11, 3);                     //Soil status.
  blankToDisplay(4, 11, 5);                     //Light Value.
  blankToDisplay(5, 11, 2);                     //UV-light value.
  blankToDisplay(6, 11, 2);                     //Temperature value.
  blankToDisplay(7, 11, 2);                     //Temperature threshold value.
  blankToDisplay(8, 11, 3);                     //Humidity value.
  blankToDisplay(9, 11, 3);                     //Water flow value.
  
  /*********************
  |Moisture mean value and soil status.|
  *********************/
  stringToDisplay(2, 0, "Moisture:");
  numberToDisplay(2, 11, moistureMeanValue);    //Moisture mean value calculated from all four moisture sensor readouts.
  
  stringToDisplay(3, 0, "Soil:");               //Prints "Dry", "OK" or "Wet" to display based on soil humidity.
  if(Config::State().moistureDry == true) {
    stringToDisplay(3, 11, "Dry");
  }
  else if(Config::State().moistureDry == false && Config::State().moistureWet == false) {
    stringToDisplay(3, 11, "OK");
  }
  else if(Config::State().moistureWet == true) {
    stringToDisplay(3, 11, "Wet");
  }

  /***************************
  |Light and UV-light values.|
  ****************************/
  stringToDisplay(4, 0, "Light:");              
  numberToDisplay(4, 11, lightValue);           //Light value, unit in lumen.

  stringToDisplay(5, 0, "UV-light:");
  numberToDisplay(5, 11, uvValue);              //UV-light value, unit in UN-index.

  /*************************************************************************
  |Temperature value and temperature threshold value set by rotary encoder.|
  **************************************************************************/
  stringToDisplay(6, 0, "Temp.:");              
  numberToDisplay(6, 11, tempValue);            //Temperature value.

  stringToDisplay(7, 0, "Temp.lim.:");              
  numberToDisplay(7, 11, Config::State().tempThresholdValue/2); //Set temperature threshold value divided by two. Adjusted by rotary encoder. Value 60 / 2 is 30°C.

  /********************
  |Air humidity value.|
  *********************/
  stringToDisplay(8, 0, "Humidity:");              
  numberToDisplay(8, 11, humidityValue);        //Air humidity value, unit in %.

  /*************************
  |Water flow sensor value.|
  **************************/
  //stringToDisplay(9, 0, "Water flw:");              
  //numberToDisplay(9, 11, waterFlowValue);       //Calculated water flow value based on the water that flows through water flow sensor. 
}

  /*
  -----------------------------------------------------------------------------
  |Bitmap image (stored as an array) to be printed on OLED display at startup.|
  ----------------------------------------------------------------------------- */
  const unsigned char greenhouse[] PROGMEM= {
  //Startup image.
0x00, 0x00, 0x00, 0x00, 0x00, 0x00, 0x00, 0x00, 0x00, 0x00, 0x00, 0x00, 0x00, 0x00, 0x00, 0x00,
0x00, 0x01, 0xE0, 0x00, 0x00, 0x00, 0x00, 0x00, 0x00, 0x00, 0x00, 0xE0, 0x00, 0x00, 0x07, 0xC0,
0x00, 0x03, 0xE1, 0x00, 0x00, 0x00, 0x00, 0x00, 0x00, 0x00, 0x01, 0x10, 0x00, 0x00, 0x04, 0xA0,
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0x00, 0x00, 0x00, 0x00, 0x00, 0x00, 0x00, 0x00, 0x00, 0x00, 0x00, 0x00, 0x00, 0x00, 0x00, 0x00
};

/*
=====================================================
|| Initialize OLED display and show startup image. ||
===================================================== */
void Display::viewStartupImage() {
  Serial.println("STARTUP_IMAGE");

  /*
  //Startup image.
  SeeedGrayOled.drawBitmap(greenhouse, 128*128/8);  //Show greenhouse logo. Second parameter in drawBitmap function specifies the size of the image in bytes. Fullscreen image = 128 * 64 pixels / 8.
  delay(4000);                                      //Image shown for 4 seconds.
  SeeedGrayOled.clearDisplay();                     //Clear the display.
  */

  displayState = SET_CLOCK;                         //Set next display mode to be printed to display.
}
