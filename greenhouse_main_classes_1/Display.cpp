#include "Display.h"
#include "Miscellaneous.h"

Clock Display::internalClock;                 //Create a temporary internal clock object from Clock class to be able to access functions within its class.
Watering Display::waterPump;                  //Create a temporary water pump object from Watering class to be able to access functions within its class.
  
/*
=================================================================
|| Run the function that corresponds to selected display mode. ||
================================================================= */
void Display::printToScreen() {
  SeeedGrayOled.setVerticalMode();            //In Vertical addressing mode the data flows from top part of display to bottom part of display, from left to right side.
  switch(displayState) {
    case STARTUP_IMAGE:
      viewStartupImage();                     //Initialize the OLED Display and print startup images to display.
      break;
    case SET_CLOCK:
      stringToDisplay(0, 7, "SET CLOCK");     //Print current display state to upper right corner of display.
      viewSetClock();                         //Display time set screen only if current time has not been set.
      internalClock.setTime();                //Reset clock time.
      break;
    case READOUT_VALUES:
      stringToDisplay(0, 2, "READOUT VALUES");//Print current display state to upper right corner of display.
      //viewReadoutValues();                  //Print read out values from the greenhouse to display.
      break;
    case SERVICE_MODE:
      stringToDisplay(0, 4, "SERVICE MODE");  //Print current display state to upper right corner of display.
      //viewServiceMode();                    //Service mode screen is printed to display.
      break;
    case FLOW_FAULT:
      stringToDisplay(0, 6, "FLOW FAULT");    //Print current display state to upper right corner of display.
      //waterFlowFault = resolveFlowFault();  //Water flow fault display mode is printed to display. It contains fault code instruction and possibility to reset fault code.  
      break;
  }
}

/*
======================================================================================
|| Toggle set modes and screen display modes when clockModeButton is being pressed. ||
====================================================================================== */
 void Display::toggleDisplayMode() {
  if((millis() - pressTimePrev) >= DEBOUNCE_TIME_PERIOD) {  //Debouncing button press to avoid multiple interrupts, display toggles.

    //Check if water flow fault code is active. If it is set 'true', FLOW_FAULT display will be activated next time mode-button is being pressed to let user resolve the fault code.
    if(waterFlowFault == true) {
      displayState = FLOW_FAULT;                //Set next display mode to be printed to display. 
    }

    switch(displayState) {
      case SET_CLOCK:
        switch(clockInputState) {
          case HOUR2:
            clockInputState = HOUR1;              //Hour pointer2 has been set. Continue by setting hour pointer1.
            Serial.println("hour1InputMode");
            break;
          case HOUR1:
            clockInputState = MINUTE2;            //Hour pointer1 has been set. Continue by setting minute pointer2.
            Serial.println("minute2InputMode");
            break;
          case MINUTE2:
            clockInputState = MINUTE1;            //Minute pointer2 has been set. Continue by setting minute pointer1.
            Serial.println("minute1InputMode");
            break;
          case MINUTE1:
            clockInputState = COMPLETED;          //Clock setting completed.
            clockStartEnabled = true;             //Start clock. Clock starts ticking.
            Serial.println("clockSettingCompleted");
            break;
          case COMPLETED:
            displayState = READOUT_VALUES;        //Set next display mode to be printed to display.
            alarmMessageEnabled = true;           //Enable any alarm message to be printed to display.
            greenhouseProgramStart = true;        //Start greenhouse program.
            Serial.println("READOUT_VALUES");
            break;           
        }
      case READOUT_VALUES:
        displayState = SERVICE_MODE;              //Set next display mode to be printed to display.
        alarmMessageEnabled = false;              //Disable any alarm message from being printed to display.
        Serial.println("SERVICE_MODE");
        break;
      case SERVICE_MODE:
        displayState = READOUT_VALUES;            //Set next display mode to be printed to display.
        alarmMessageEnabled = false;              //Disable any alarm message from being printed to display.
        Serial.println("READOUT_VALUES");     
        break;
      case FLOW_FAULT:
        greenhouseProgramStart = false;           //Stop greenhouse program.
        alarmMessageEnabled = false;              //Disable any alarm message from being printed to display.
        Serial.println("FLOW_FAULT"); 

        //In flow fault display mode user will have the chance to clear the fault code. Check if water flow fault code has been cleared by user or not.
        if(waterFlowFault == false) {               //Fault code has been cleared by user. Continue to run greenhouse program.               
          displayState = SERVICE_MODE;              //Since using interrupt for toggeling display mode, next display mode to be printed to display is READOUT_VALUES even though SERVICE_MODE display is set active mode here.
          greenhouseProgramStart = true;            //Continue greenhouse program.
          alarmMessageEnabled = true;               //Enable any alarm message from being printed to display.
          Serial.println("Resume program");  
        }
        else if(waterFlowFault == true) {           //If flow fault code has not been cleared, reboot greenhouse program.
          waterFlowFault = false;                   //Clear water flow fault code.
          waterPump.stopPump();
          internalClock.resetTime();                //Reset clock time.
          displayState = STARTUP_IMAGE;             //Set next display mode to be printed to display.                
          Serial.println("Reboot program");             
        }
        break;
    }
    pressTimePrev = millis();
  }
}

/*
===================================
|| Print custom text to display. ||
=================================== */
void Display::stringToDisplay(unsigned char x, unsigned char y, char* text) {
  y *= 8;                                         //To align symbol with rest printed text. Each symbol requires 8px in width.
  SeeedGrayOled.setTextXY(x, y);                  //Set cordinates to where text will be printed. X = row (0-7), Y = column (0-127).
  SeeedGrayOled.putString(text);                  //Print text to display.
}

/*
=======================================
|| Print number variable to display. ||
======================================= */
void Display::numberToDisplay(unsigned char x, unsigned char y, int variable) {
  y *= 8;                                         //To align symbol with rest printed text. Each symbol requires 8px in width.
  SeeedGrayOled.setTextXY(x, y);                  //Set cordinates to where text will be printed. X = row (0-7), Y = column (0-127).
  SeeedGrayOled.putNumber(variable);              //Print value to display.
}

/*
======================================================
|| Clear any character/s (print blanks) at display. ||
====================================================== */
void Display::blankToDisplay(unsigned char x, unsigned char y, int numOfBlanks) {
  y *= 8;                                         //To align symbol with rest printed text. Each symbol requires 8px in width.
  for(int i=0; i<numOfBlanks; i++) {              //Print blank space to display. Each loop one blank space is printed.
    SeeedGrayOled.setTextXY(x, y);                //Set cordinates to where text will be printed. X = row (0-7), Y = column (0-127).
    SeeedGrayOled.putString(" ");                 //Blank symbol.
    y++;                                          //Increase column cordinate to print next blank space in the same row.
  }
}

/*
==========================================================================================
|| Alternate print and clear variable value (flash) to display with a frequency of 2Hz. ||
========================================================================================== */
void Display::flashNumberDisplay(unsigned short x, unsigned short y, unsigned short variable) {
  unsigned short numDigits = 0;               //Store number of digits in variable value;
  if(variable == 0) {                         //If variable equal to 0 it contains 1 digit.
    numDigits = 1;
  }
  while(variable != 0) {
    numDigits++;
    variable /= 10;                           //Result of division between values with type 'int' only gives an integer. If variable less than 10 result of division is 0.
  }

  if(characterFlashEnabled == true) {
    for(int i=0; i<numDigits; i++) {          //Print blank space to display. Each loop one blank space is printed.
      SeeedGrayOled.setTextXY(x, y);              //Set cordinates to where text will be printed. X = row (0-7), Y = column (0-127).
      SeeedGrayOled.putString(" ");               //Blank symbol.
      y++;                                    //Increase column cordinate to print next blank space in the same row.
    }
  }
  else {
    SeeedGrayOled.setTextXY(x, y);                //Set cordinates to where text will be printed. X = row (0-7), Y = column (0-127).
    SeeedGrayOled.putNumber(variable);            //Print variable value.
  }
}

/*
=========================================================================
|| Print current clock values to display to let user set current time. ||
========================================================================= */
void Display::viewSetClock() {
  Serial.println("SET_CLOCK");
  
  stringToDisplay(2, 0, "Set current time");
  stringToDisplay(3, 0, "Use the buttons:");
  stringToDisplay(5, 0, "SET = inc. p.val");
  stringToDisplay(6, 0, "MODE = h or min");
 
  stringToDisplay(9, 4, "HH MM SS");
  stringToDisplay(10, 6, ":");
  stringToDisplay(10, 9, ":");

  numberToDisplay(10, 4, hourPointer2);
  numberToDisplay(10, 5, hourPointer1);
  numberToDisplay(10, 7, minutePointer2);
  numberToDisplay(10, 8, minutePointer1);
  numberToDisplay(10, 10, secondPointer2);
  numberToDisplay(10, 11, secondPointer2);
}

//Add the function alarms to display!! Write alarms to display. alarmMessageDisplay()

  /*
  -----------------------------------------------------------------------------
  |Bitmap image (stored as an array) to be printed on OLED display at startup.|
  ----------------------------------------------------------------------------- */
  const unsigned char greenhouse[] PROGMEM= {
  //Startup image.
0x00, 0x00, 0x00, 0x00, 0x00, 0x00, 0x00, 0x00, 0x00, 0x00, 0x00, 0x00, 0x00, 0x00, 0x00, 0x00,
0x00, 0x01, 0xE0, 0x00, 0x00, 0x00, 0x00, 0x00, 0x00, 0x00, 0x00, 0xE0, 0x00, 0x00, 0x07, 0xC0,
0x00, 0x03, 0xE1, 0x00, 0x00, 0x00, 0x00, 0x00, 0x00, 0x00, 0x01, 0x10, 0x00, 0x00, 0x04, 0xA0,
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0x00, 0x00, 0x00, 0x00, 0x00, 0x00, 0x00, 0x00, 0x00, 0x00, 0x00, 0x00, 0x00, 0x00, 0x00, 0x00
};

/*
=====================================================
|| Initialize OLED display and show startup image. ||
===================================================== */
void Display::viewStartupImage() {
  Serial.println("STARTUP_IMAGE");

  
  //Startup image.
  SeeedGrayOled.drawBitmap(greenhouse, 128*128/8);  //Show greenhouse logo. Second parameter in drawBitmap function specifies the size of the image in bytes. Fullscreen image = 128 * 64 pixels / 8.
  delay(4000);                                      //Image shown for 4 seconds.
  SeeedGrayOled.clearDisplay();                     //Clear the display.
  

  displayState = SET_CLOCK;                         //Set next display mode to be printed to display.
}
